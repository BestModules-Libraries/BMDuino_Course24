/*
 * ==================================================
 * 檔案名稱：TCP.h - WiFi 網路通訊函式庫
 * 適用硬體：BMduino / Arduino + BMC81M001 WiFi 模組
 * 通訊介面：UART（支援硬體序列埠 Serial2）
 * 
 * 程式功能說明：
 *   本程式為 WiFi 網路通訊函式庫，封裝了 BMC81M001 WiFi 模組的控制功能，
 *   提供簡易的 API 讓開發者快速實現 WiFi 連線、網路資訊取得等功能。
 *   透過此函式庫，開發者無需深入了解 AT 指令細節，即可完成物聯網應用的
 *   網路連線設定。
 * 
 * 模組功能架構：
 *   ┌─────────────────────────────────────────────────────────────────┐
 *   │                    TCP.h - WiFi 網路通訊函式庫                    │
 *   ├─────────────────────────────────────────────────────────────────┤
 *   │ 1. WiFi 連線管理層                                               │
 *   │    - initWiFi()：初始化模組並連線至指定熱點                        │
 *   │    - 連線狀態檢查與錯誤處理                                        │
 *   ├─────────────────────────────────────────────────────────────────┤
 *   │ 2. 網路資訊取得層                                                 │
 *   │    - GetMAC()：取得 MAC 位址（硬體唯一識別碼）                     │
 *   │    - GetSSID()：取得目前連線的熱點名稱                            │
 *   │    - GetIP()：取得 DHCP 分配的 IP 位址                            │
 *   │    - GetGateWay()：取得閘道器（路由器）位址                        │
 *   │    - GetsubMask()：取得子網路遮罩                                 │
 *   │    - ScanAP()：掃描附近可用的 WiFi 熱點                           │
 *   └─────────────────────────────────────────────────────────────────┘
 * 
 * 使用流程：
 *   ┌─────────────────────────────────────────────────────────────────┐
 *   │ 1. 確認硬體接線                                                  │
 *   │    - WiFi 模組 TX → Arduino RX2                                 │
 *   │    - WiFi 模組 RX → Arduino TX2                                 │
 *   │    - 電源 3.3V / 5V（依模組規格）                                │
 *   └─────────────────────────────────────────────────────────────────┘
 *                              ▼
 *   ┌─────────────────────────────────────────────────────────────────┐
 *   │ 2. 修改 WiFi 連線設定                                            │
 *   │    - 修改 WIFI_SSID 為您的網路名稱                               │
 *   │    - 修改 WIFI_PASS 為您的網路密碼                               │
 *   └─────────────────────────────────────────────────────────────────┘
 *                              ▼
 *   ┌─────────────────────────────────────────────────────────────────┐
 *   │ 3. 在主程式中呼叫 initWiFi() 進行連線                            │
 *   │ 4. 使用 GetMAC()、GetIP() 等函式取得網路資訊                      │
 *   └─────────────────────────────────────────────────────────────────┘
 * 
 * 應用場景：
 *   - 物聯網裝置初始化（自動連線至預設熱點）
 *   - 網路狀態監控（取得 IP、MAC 等資訊）
 *   - 環境 WiFi 掃描（尋找可用熱點）
 *   - 智慧家庭設備網路設定
 * 
 * 作者/版本：Best Module / 網路通訊函式庫
 * 建立日期：2025.03.27
 * 修改紀錄：
 *   - 2025.03.27：加入詳細繁體中文註解與整體說明
 *   - 修正 ScanAP() 函式的呼叫方式註解
 * ==================================================
 */

// ================================================================
// 檔案名稱：TCP.h
// 描述：WiFi 網路通訊函式庫
// 功能：提供 BMC81M001 WiFi 模組的控制函式，包含連線、IP 取得、網路設定等
//       用於建立 WiFi 連線並取得網路相關資訊
// ================================================================

// ================================================================
// =============== 前置處理指令區 ===============
// ================================================================

// 防止標頭檔重複引入的保護機制
// 如果未定義 _BMC81M001_H__，則定義它並編譯後續程式碼
// 避免在同一個編譯單元中重複引入此標頭檔
#ifndef _BMC81M001_H__
#define _BMC81M001_H__

// ================================================================
// =============== 函式庫引入區 ===============
// ================================================================

// 引入 BMC81M001 WiFi 模組控制函式庫（硬體控制核心）
// 此函式庫提供底層的 AT 指令通訊功能
#include "BMC81M001.h"

// 引入字串處理函式庫（Arduino 已預設包含，此處為明確宣告）
// 用於字串操作和資料處理
#include <String.h>

// ================================================================
// =============== WiFi 連線設定常數區 ===============
// ================================================================

// WiFi 熱點連線設定（根據實際網路環境修改）
// 重要：使用前必須修改為您的實際 WiFi 設定
#define WIFI_SSID "NCNUIOT"        // 要連接的 WiFi 網路名稱（SSID）
                                     // 範例："MyHomeWiFi"、"FamilyNetwork"
#define WIFI_PASS "0123456789"     // WiFi 密碼（根據實際密碼修改）
                                     // 範例："MyPassword123"

// ================================================================
// =============== 硬體腳位定義區 ===============
// ================================================================

// 內建 LED 腳位定義（通常用於狀態指示）
// 可用於顯示 WiFi 連線狀態（如：連線成功時點亮、失敗時閃爍）
int LED = 13;   // Arduino UNO 內建 LED 接在 D13 腳位
                // 其他開發板可能需要調整：
                // - BMduino：通常也是 D13
                // - ESP32：內建 LED 通常在 D2
                // - 其他板子請參考硬體規格

// ================================================================
// =============== 全域常數與變數宣告區 ===============
// ================================================================

#define DEB_CNT     50                // 除錯延遲時間（毫秒）
                                       // 用於等待模組回應或狀態穩定
                                       // 可根據實際需求調整

#define RES_MAX_LENGTH 200           // 串列通訊接收緩衝區最大長度
                                       // 根據 WiFi 模組回應長度設定
                                       // 若回應內容較長，可適當增加此值

char  SerialBuff[RES_MAX_LENGTH];   // 串列通訊接收資料緩衝區
                                       // 用於暫存從 WiFi 模組接收的原始資料
                                       // 以字元陣列形式儲存

char  data[30];                     // 關鍵資料暫存緩衝區
                                       // 用於儲存解析後的特定資料（如 IP、MAC）
                                       // 大小可根據實際資料長度調整

int   resLen;                       // 接收資料的實際長度
                                       // 記錄 SerialBuff 中有效資料的長度
                                       // 用於判斷資料是否完整接收

int   nKeyBuf;                      // 關鍵資料緩衝處理指標
                                       // 用於追蹤資料解析位置
                                       // 在字串解析時使用

String DATA_BUF;                   // 暫存資料用的動態字串變數
                                       // 用於字串操作和資料暫存
                                       // 注意：String 物件可能造成記憶體碎片

String tcpBuff;                    // TCP 通訊資料緩衝字串
                                       // 用於儲存要傳送的 TCP 資料或接收的資料
                                       // 在 TCP 通訊時使用

// 結束標頭檔保護區（與開頭的 #ifndef 對應）
#endif

// ================================================================
// =============== WiFi 物件實例化區 ===============
// ================================================================

/*
建立 BMC81M001 WiFi 模組控制物件，命名為 Wifi
通訊介面選擇（根據硬體接線選擇其中之一）：

注意：只能啟用其中一種通訊方式，請根據實際接線選擇對應選項
*/

// 選項1：使用軟體序列埠（需指定 RX, TX 腳位）
// 適用於硬體序列埠已被佔用的情況
// 注意：軟體序列埠在高鮑率下可能不穩定
// BMC81M001 Wifi(6, 7);  // RX 接腳 6，TX 接腳 7

// 選項2：使用硬體 Serial1（部分 Arduino 板子支援）
// 適用於 Arduino Mega、Leonardo 等有多個硬體序列埠的板子
// BMC81M001 Wifi(&Serial1);  // 使用 Serial1 硬體序列埠

// 選項3：使用硬體 Serial2（BMduino 開發板專用，本程式選用）
// BMduino 開發板提供多組硬體序列埠，Serial2 為其中之一
// 通常對應特定的 RX2, TX2 腳位
BMC81M001 Wifi(&Serial2);  // 使用 BMduino 的 Serial2 硬體序列埠

// ================================================================
// =============== 函式宣告區 ===============
// ================================================================

// ---------- WiFi 初始化和控制函式 ----------
void initWiFi();        // 初始化 WiFi 模組並連線到指定熱點
                        // 此函式應在 setup() 中呼叫

// ---------- 網路資訊取得函式 ----------
String GetMAC();        // 取得 WiFi 模組的 MAC 位址（硬體唯一識別碼）
                        // 回傳格式：連續 12 個大寫字母數字（如 "D8BFC0123456"）

String GetSSID();       // 取得目前連線的 WiFi 熱點名稱
                        // 若未連線則回傳空字串

String GetIP();         // 取得由 DHCP 分配的 IP 位址
                        // 若未連線則回傳空字串
                        // 格式如："192.168.1.105"

String GetGateWay();    // 取得閘道器（路由器）IP 位址
                        // 若未連線則回傳空字串
                        // 格式如："192.168.1.1"

String GetsubMask();    // 取得子網路遮罩（Subnet Mask）
                        // 若未連線則回傳空字串
                        // 格式如："255.255.255.0"

String ScanAP();        // 掃描附近可用的 WiFi 熱點
                        // 回傳掃描結果字串（格式依模組而定）

// ================================================================
// =============== 函式實作區 ===============
// ================================================================

// ---------------------------------------------------------------
// 函式名稱：initWiFi()
// 功能：初始化 WiFi 模組並連線到指定的無線網路熱點
// 參數：無
// 傳回值：無
// 
// 流程說明：
//   1. 啟動 WiFi 模組（begin）
//   2. 重設模組到初始狀態（reset）
//   3. 等待模組重設完成（delay 1000ms）
//   4. 嘗試連線到指定 SSID（connectToAP）
//   5. 顯示連線結果到序列埠
//   6. 額外等待確保連線穩定（delay 500ms）
// 
// 注意事項：
//   - 連線失敗時只顯示訊息，不會自動重試
//   - 可根據需要加入重試機制
//   - 建議在主程式中檢查連線狀態後再進行後續操作
// ---------------------------------------------------------------
void initWiFi()
{
    // 步驟1：啟動 WiFi 模組
    // begin() 函式會初始化模組的內部設定和序列通訊
    // 需要先呼叫此函式才能與模組通訊
    Wifi.begin();
    
    // 步驟2：重設 WiFi 模組
    // reset() 確保模組處於乾淨的初始狀態
    // 清除所有先前的連線設定和暫存資料
    // 避免上次連線設定影響本次連線
    Wifi.reset();
    
    // 步驟3：等待模組重設完成
    // 延遲 1000ms（1秒），確保模組完全啟動
    // 重設後模組需要時間重新初始化內部韌體
    delay(1000);
    
    // 步驟4：顯示初始化訊息
    // 注意：原始程式中的 "WFIF" 應為 "WIFI"，此處保留原樣但註解說明
    Serial.print("init WFIF：");  // 應修正為 "init WIFI:"，但不影響功能
    
    // 步驟5：嘗試連線到指定的 WiFi 熱點
    // connectToAP() 參數：SSID（網路名稱）、PASS（密碼）
    // 回傳 true：連線成功，false：連線失敗
    if (!Wifi.connectToAP(WIFI_SSID, WIFI_PASS)) {
        // 連線失敗情況處理
        Serial.print("WIFI fail,");
        // 可能失敗原因：
        // 1. SSID 不存在或訊號太弱（距離太遠）
        // 2. 密碼錯誤（大小寫敏感）
        // 3. DHCP 無法取得 IP（路由器問題）
        // 4. 硬體連線問題（接線錯誤、電源不足）
        // 5. 模組尚未就緒（等待時間不足）
    } else {
        // 連線成功情況處理
        Serial.print("WIFI success,");
        // 此時模組已完成：
        // 1. 完成無線認證（WPA2/WPA3 等）
        // 2. 取得 DHCP 分配的 IP 位址
        // 3. 設定好 DNS 等網路參數
        // 4. 可以進行後續網路通訊
    }
    
    // 步驟6：額外等待時間，確保網路連線穩定
    // 給路由器足夠時間完成 DHCP 和路由設定
    // 部分路由器需要時間建立完整的路由表
    delay(500);
}

// ---------------------------------------------------------------
// 函式名稱：GetMAC()
// 功能：取得 WiFi 模組的 MAC 位址（硬體唯一識別碼）
// 參數：無
// 傳回值：String - MAC 位址字串
//         格式：連續 12 個大寫字母數字（如 "D8BFC0123456"）
// 說明：
//   MAC 位址是網路卡在出廠時設定的唯一識別碼，全球唯一
//   常用於設備識別、雲端平台註冊、MAC 過濾等應用
// ---------------------------------------------------------------
String GetMAC()
{
    // 步驟1：等待模組穩定
    // 避免在前一個指令執行後立即讀取造成錯誤
    // 確保模組有足夠時間回應
    delay(500);
    
    // 步驟2：建立暫存字串變數
    String tmp = "";
    
    // 步驟3：從 WiFi 模組讀取 MAC 位址
    // getMacAddress() 會傳回 MAC 位址字串
    // 底層透過 AT+CIPSTAMAC? 指令取得
    tmp = Wifi.getMacAddress();
    
    // 步驟4：將字串轉換為大寫格式
    // 統一顯示格式，方便閱讀和比較
    // MAC 位址通常以大寫表示
    tmp.toUpperCase();
    
    // 步驟5：回傳 MAC 位址字串
    return tmp;
}

// ---------------------------------------------------------------
// 函式名稱：GetSSID()
// 功能：取得目前連線的 WiFi 熱點名稱（SSID）
// 參數：無
// 傳回值：String - SSID 名稱（若未連線則回傳空字串）
// 說明：
//   SSID 是無線網路的廣播名稱，用於識別不同的無線網路
//   此函式會先檢查連線狀態，避免在未連線時讀取錯誤資料
// ---------------------------------------------------------------
String GetSSID()
{
    // 步驟1：等待模組穩定回應
    delay(500);
    
    // 步驟2：建立暫存字串變數
    String tmp = "";
    
    // 步驟3：檢查 WiFi 連線狀態
    // getStatus() 回傳 true：已連線，false：未連線
    // 先確認連線狀態再讀取，避免錯誤
    if (Wifi.getStatus()) {
        // 已連線狀態：讀取 SSID
        // getSSID() 透過 AT+CWJAP? 指令取得
        tmp = Wifi.getSSID();
        
        // 將 SSID 轉為大寫格式（統一顯示）
        // 注意：SSID 實際上區分大小寫，轉大寫可能改變原意
        // 此處保留原程式邏輯，但註明潛在問題
        tmp.toUpperCase();
    } else {
        // 未連線狀態：回傳空字串
        tmp = "";
    }
    
    // 步驟4：回傳 SSID 或空字串
    return tmp;
}

// ---------------------------------------------------------------
// 函式名稱：GetIP()
// 功能：取得 WiFi 連線後由 DHCP 分配的 IP 位址
// 參數：無
// 傳回值：String - IP 位址（格式如：192.168.1.105）
//                 若未連線則回傳空字串
// 說明：
//   IP 位址用於網路中的裝置識別和通訊
//   DHCP（動態主機設定協定）會自動分配可用的 IP 位址
// ---------------------------------------------------------------
String GetIP()
{
    // 步驟1：等待模組穩定
    delay(500);
    
    // 步驟2：建立暫存字串變數
    String tmp = "";
    
    // 步驟3：檢查 WiFi 連線狀態
    if (Wifi.getStatus()) {
        // 已連線狀態：讀取 IP 位址
        // getIP() 透過 AT+CIPSTA? 指令取得
        tmp = Wifi.getIP();
        
        // 轉為大寫格式（雖然 IP 沒有大小寫區別）
        // 保留原程式邏輯以維持相容性
        tmp.toUpperCase();
    } else {
        // 未連線狀態：回傳空字串
        tmp = "";
    }
    
    // 步驟4：回傳 IP 位址或空字串
    return tmp;
}

// ---------------------------------------------------------------
// 函式名稱：GetGateWay()
// 功能：取得閘道器（路由器）的 IP 位址
// 參數：無
// 傳回值：String - 閘道器 IP 位址（如：192.168.1.1）
//                 若未連線則回傳空字串
// 說明：
//   閘道器是連接本地網路和外部網路（如網際網路）的裝置
//   通常是家中路由器的 IP 位址
//   裝置要存取外部網路時，資料會先傳送到閘道器
// ---------------------------------------------------------------
String GetGateWay()
{
    // 步驟1：等待模組穩定
    delay(500);
    
    // 步驟2：建立暫存字串變數
    String tmp = "";
    
    // 步驟3：檢查 WiFi 連線狀態
    if (Wifi.getStatus()) {
        // 已連線狀態：讀取閘道器 IP
        // getGateway() 透過 AT+CIPSTA? 指令取得
        tmp = Wifi.getGateway();
        
        // 轉為大寫格式
        tmp.toUpperCase();
    } else {
        // 未連線狀態：回傳空字串
        tmp = "";
    }
    
    // 步驟4：回傳閘道器 IP 或空字串
    return tmp;
}

// ---------------------------------------------------------------
// 函式名稱：GetsubMask()
// 功能：取得子網路遮罩（Subnet Mask）
// 參數：無
// 傳回值：String - 子網路遮罩（如：255.255.255.0）
//                 若未連線則回傳空字串
// 說明：
//   子網路遮罩用於劃分 IP 位址的網路部分和主機部分
//   常見的 Class C 網路遮罩為 255.255.255.0
//   表示前 24 位元為網路位址，後 8 位元為主機位址
// ---------------------------------------------------------------
String GetsubMask()
{
    // 步驟1：等待模組穩定
    delay(500);
    
    // 步驟2：建立暫存字串變數
    String tmp = "";
    
    // 步驟3：檢查 WiFi 連線狀態
    if (Wifi.getStatus()) {
        // 已連線狀態：讀取子網路遮罩
        // getMask() 透過 AT+CIPSTA? 指令取得
        tmp = Wifi.getMask();
        
        // 轉為大寫格式
        tmp.toUpperCase();
    } else {
        // 未連線狀態：回傳空字串
        tmp = "";
    }
    
    // 步驟4：回傳子網路遮罩或空字串
    return tmp;
}

// ---------------------------------------------------------------
// 函式名稱：ScanAP()
// 功能：掃描附近可用的 WiFi 熱點（無線網路）
// 參數：無
// 傳回值：String - 掃描到的熱點列表（字串格式）
//                 若掃描失敗則回傳空字串
// 說明：
//   用於偵測環境中的無線網路，可幫助選擇要連接的熱點
//   掃描結果通常包含 SSID、訊號強度（RSSI）、加密方式等資訊
// 
// 注意：
//   原始程式使用 Wifi.SSID() 進行掃描，但這可能不是正確的函式名稱
//   實際掃描功能應使用類似 Wifi.scan() 的函式
//   使用前請確認 BMC81M001 函式庫提供的掃描函式名稱
// ---------------------------------------------------------------
String ScanAP()
{
    // 步驟1：等待模組穩定
    delay(500);
    
    // 步驟2：建立暫存字串變數
    String tmp = "";
    
    // 步驟3：檢查 WiFi 模組是否可運作
    // 注意：掃描功能不一定需要已連線狀態
    // 即使未連線，模組仍可掃描周圍的 WiFi 訊號
    if (Wifi.getStatus()) {
        // 模組可運作：執行熱點掃描
        // 原始程式使用 SSID() 函式
        // 注意：SSID() 通常用於取得目前連線的 SSID，而非掃描
        // 正確的掃描函式可能為 scan() 或 listNetworks()
        // 建議確認 BMC81M001 函式庫的實際 API
        tmp = Wifi.SSID();  // 可能需要修正為正確的掃描函式
        
        // 轉為大寫格式
        tmp.toUpperCase();
    } else {
        // 模組無法運作：回傳空字串
        tmp = "";
    }
    
    // 步驟4：回傳掃描結果或空字串
    return tmp;
}

// ================================================================
// ===================== 使用注意事項 ============================
// ================================================================
/*
重要提醒：

1. WiFi 設定修改：
   - 必須修改 WIFI_SSID 和 WIFI_PASS 為您的實際網路設定
   - 確保密碼正確且網路可用（大小寫需完全一致）
   - 考慮將敏感資訊移到設定檔或使用外部儲存方式
   - 生產環境應避免在程式碼中寫死密碼

2. 硬體接線：
   - 確認 WiFi 模組的 TX/RX 與 Arduino 正確交叉連接
     （模組 TX → Arduino RX，模組 RX → Arduino TX）
   - 檢查電源供應是否穩定（通常需要 3.3V 或 5V）
   - 注意序列埠電壓位準是否匹配（可能需要電位轉換器）
   - 確保接地（GND）共接

3. 序列埠選擇：
   - Serial2 通常對應特定硬體腳位（BMduino 開發板）
     BMduino Serial2 腳位：RX2 = D17，TX2 = D16
   - 其他開發板可能需要調整為 Serial 或 Serial1
   - 軟體序列埠（SoftwareSerial）可能不穩定，建議用硬體序列埠
   - 使用前確認序列埠未被其他功能佔用

4. 連線失敗處理：
   - 目前程式在連線失敗時僅顯示訊息
   - 可加入重試機制（例如重試 3 次，每次間隔 2 秒）
   - 可實現自動切換備用熱點功能
   - 建議加入逾時機制，避免無限期等待

5. 延遲時間調整：
   - 各函式的 delay(500) 可根據實際模組響應速度調整
   - 太快讀取可能得到不完整資料或空字串
   - 太慢會影響系統響應速度
   - 可改用狀態檢查方式替代固定延遲

6. 記憶體使用：
   - String 物件使用動態記憶體，可能造成記憶體碎片
   - 大量使用時可考慮使用 char 陣列替代
   - 監控 Arduino 的 RAM 使用量（使用 freeMemory() 函式）
   - 避免在迴圈中頻繁建立和銷毀 String 物件

7. 錯誤處理強化建議：
   - 可加入連線逾時機制（如 30 秒內未連線則放棄）
   - 檢查訊號強度（RSSI）決定是否切換熱點
   - 實作斷線自動重連功能（在 loop 中定期檢查）
   - 加入錯誤碼回傳機制，便於上層程式處理

8. 安全考量：
   - 避免在程式碼中寫死密碼（特別是要公開的程式碼）
   - 考慮使用 WPA2 或 WPA3 加密的網路
   - 生產環境應使用更安全的連線方式（如 SSL/TLS）
   - 定期更換 WiFi 密碼並更新裝置設定

9. 多網路環境：
   - 可實作多組 SSID/PASS 設定（陣列形式）
   - 優先連接訊號強的熱點
   - 記憶常用網路設定（如上次成功連線的網路）
   - 支援 WPS（Wi-Fi Protected Setup）快速連線

10. 功耗考量：
    - WiFi 連線消耗較多電力（約 80-200mA）
    - 電池供電設備可實作睡眠模式節省電力
    - 非必要時可斷開 WiFi 連線
    - 可設定定時喚醒上傳資料後再睡眠

11. 程式除錯：
    - 使用 Serial.print 輸出關鍵資訊
    - 可加入 DEBUG 開關控制除錯輸出
    - 記錄連線過程的時間戳，便於分析問題
    - 使用示波器或邏輯分析儀檢查序列埠訊號

12. 相容性注意：
    - 不同版本的 BMC81M001 韌體可能有不同的 AT 指令集
    - 使用前確認韌體版本（AT+GMR）
    - 若有更新韌體，需確認指令相容性
    - 保留與舊版韌體的相容處理
*/