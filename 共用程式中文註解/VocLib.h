/*
 * ==================================================
 * 檔案名稱：VocLib.h - 語音控制自訂函式庫
 * 適用硬體：BMV31T001 語音播放模組
 * 通訊介面：I2C / UART（依模組設定）
 * 
 * 程式功能說明：
 *   本程式為 BMV31T001 語音模組的自訂控制函式庫，提供完整的語音播放控制功能。
 *   透過此函式庫，開發者可以輕鬆實現語音提示、數字念讀、溫度/濕度播報等功能，
 *   適用於智慧家電、語音導覽、警示系統等應用場景。
 * 
 * 模組功能架構：
 *   ┌─────────────────────────────────────────────────────────────────┐
 *   │                    VocLib.h - 語音控制函式庫                      │
 *   ├─────────────────────────────────────────────────────────────────┤
 *   │ 1. 基礎控制層                                                   │
 *   │    - initVoice()：初始化語音模組                                 │
 *   │    - setVolume()：設定音量等級（0~11）                           │
 *   │    - setVoicePower()：控制模組電源開關                          │
 *   │    - setVoiceLed()：控制狀態指示燈                              │
 *   ├─────────────────────────────────────────────────────────────────┤
 *   │ 2. 播放控制層                                                   │
 *   │    - play()：播放單段語音（不循環）                              │
 *   │    - playloop()：循環播放單段語音                                │
 *   │    - playsentence()：播放語句模式                                │
 *   │    - playsentenceloop()：循環播放語句                            │
 *   │    - playstop()：停止播放                                        │
 *   │    - playPause()：暫停播放                                       │
 *   │    - playContinue()：繼續播放                                    │
 *   │    - playRepeat()：重複播放                                      │
 *   │    - isPlaying()：檢查播放狀態                                   │
 *   ├─────────────────────────────────────────────────────────────────┤
 *   │ 3. 高階語音介面層                                               │
 *   │    - saynumber()：念出單一數字（0~9）                            │
 *   │    - SpeakStringNumber()：念出數字字串（含小數點、負號）         │
 *   │    - SayTemperature()：播報溫度（含單位）                        │
 *   │    - SayHumidity()：播報濕度（含單位）                           │
 *   │    - SayHello()：播放歡迎語                                      │
 *   │    - SayString()：播放指定語音（單段或兩段連續）                 │
 *   │    - sayText()：播放語音表中指定索引的語音                       │
 *   ├─────────────────────────────────────────────────────────────────┤
 *   │ 4. 輸入控制層                                                   │
 *   │    - getBoardKey()：讀取模組板載按鍵狀態                         │
 *   │    - DisplayVoiceStatus()：顯示播放狀態（LED 控制）              │
 *   └─────────────────────────────────────────────────────────────────┘
 * 
 * 使用流程：
 *   ┌─────────────────────────────────────────────────────────────────┐
 *   │ 1. 硬體接線確認                                                  │
 *   │    - 連接 BMV31T001 模組的 I2C 或 UART 腳位                     │
 *   │    - 確保電源供應穩定（3.3V 或 5V）                              │
 *   └─────────────────────────────────────────────────────────────────┘
 *                              ▼
 *   ┌─────────────────────────────────────────────────────────────────┐
 *   │ 2. 初始化語音模組                                                │
 *   │    - 在 setup() 中呼叫 initVoice()                               │
 *   │    - 確認語音檔已透過 PC 工具寫入模組                            │
 *   └─────────────────────────────────────────────────────────────────┘
 *                              ▼
 *   ┌─────────────────────────────────────────────────────────────────┐
 *   │ 3. 使用語音功能                                                  │
 *   │    - SayHello()：播放歡迎語                                      │
 *   │    - SayTemperature("25.5")：播報溫度                            │
 *   │    - SpeakStringNumber("123.45")：念出數字                       │
 *   │    - play(voice_table[0])：播放第一段語音                        │
 *   └─────────────────────────────────────────────────────────────────┘
 * 
 * 語音編號說明（voice_table 索引對應）：
 *   索引 0~37 對應 VOC_1 ~ VOC_38 語音編號
 *   常用語音編號定義：
 *     - VOC_11：小數點（「點」）
 *     - VOC_12：負號（「負」）
 *     - VOC_13：歡迎語（如「歡迎使用」）
 *     - VOC_14：溫度提示（如「現在溫度」）
 *     - VOC_15：濕度提示（如「現在濕度」）
 *     - VOC_16：溫度單位（「攝氏度」）
 *     - VOC_17：濕度單位（「百分比」）
 * 
 * 應用場景：
 *   - 智慧家電語音提示（開機、模式切換、操作完成）
 *   - 環境監測語音播報（溫度、濕度、空氣品質）
 *   - 門禁系統語音警示（「門已開啟」、「入侵警報」）
 *   - 互動式語音導覽系統
 *   - 工業設備狀態語音提醒
 * 
 * 作者/版本：Best Module / 語音控制函式庫
 * 建立日期：2025.03.27
 * 修改紀錄：
 *   - 2025.03.27：加入詳細繁體中文註解與整體說明
 * ==================================================
 */

//**************************************************************
// 自訂語音控制函式模組
// 主要負責：初始化 BMV31T001 語音模組、控制播放 / 暫停 / 重複 / 音量、
//         以及提供數字念讀、溫度、濕度與一般提示語的播放介面。
//**************************************************************
/******************************************************************
設計說明(Note): 
  本模組使用 BMV31T001 語音播放模組，搭配事先寫入的語音檔，
  透過函式呼叫即可播放對應的語音內容。
******************************************************************/

// ================================================================
// =============== 外部函式庫引入區 ===============
// ================================================================

// 引入 BMV31T001 語音模組驅動程式函式庫
// 提供底層的語音播放、音量控制、電源管理等基本功能
#include "BMV31T001.h"

// 引入語音編號列表（包含 VOC_1 ~ VOC_38 等常數定義）
// 這些常數對應到寫入模組的語音檔編號
#include "voice_cmd_list.h"

// ================================================================
// =============== 語音模組物件實例化區 ===============
// ================================================================

// 建立 BMV31T001 語音模組物件
// 此物件用於呼叫所有底層語音控制功能
BMV31T001 myBMV31T001;   // 宣告一個語音模組物件，用來呼叫 begin / playVoice / setPower 等方法

// ================================================================
// =============== 全域變數宣告與設定區 ===============
// ================================================================

// 定義目前語音清單中可用的語音總數（共 38 段）
// 此數字應與實際寫入模組的語音數量一致
#define VOICE_TOTAL_NUMBER 38

// 建立語音對應表：
//   voice_table[i] 對應到 voice_cmd_list.h 中的 VOC_xx 宏定義
//   方便以索引方式依序播放或指定某一筆語音
//   例如：voice_table[0] = VOC_1，voice_table[10] = VOC_11
const uint8_t voice_table[VOICE_TOTAL_NUMBER] = {
    VOC_1,  VOC_2,  VOC_3,  VOC_4,  VOC_5,  VOC_6,  VOC_7,  VOC_8,  VOC_9,  VOC_10,
    VOC_11, VOC_12, VOC_13, VOC_14, VOC_15, VOC_16, VOC_17, VOC_18, VOC_19, VOC_20,
    VOC_21, VOC_22, VOC_23, VOC_24, VOC_25, VOC_26, VOC_27, VOC_28, VOC_29, VOC_30,
    VOC_31, VOC_32, VOC_33, VOC_34, VOC_35, VOC_36, VOC_37, VOC_38
};

// ================================================================
// =============== 狀態變數區 ===============
// ================================================================

uint8_t keyStatus;      // 當前一次掃描到的按鍵狀態（即時狀態）
uint8_t lastKeyStatus;  // 上一次掃描到的按鍵狀態，可用於判斷「狀態改變」
                        // 例如：按鍵從未按下變為按下時，可觸發對應事件

uint8_t playStatus;     // 播放狀態：BMV31T001_BUSY 或 BMV31T001_NOBUSY
                        // BMV31T001_BUSY：正在播放語音
                        // BMV31T001_NOBUSY：閒置或停止

uint8_t playNum;        // 目前播放中的語音編號
                        // 可用來做上一首 / 下一首等功能

// 預設音量等級（0~11，共 12 級）
// 0 = 靜音，1-10 = 逐漸增大，11 = 最大音量
#define DEFAULT_VOLUME 9
uint8_t volume = DEFAULT_VOLUME; // 目前音量設定值

uint8_t keycode = 0;             // 暫存從語音模組讀取到的按鍵代碼

/*
按鍵代碼對照表說明：
  不按：0
  中鍵：1  （Confirm / OK）
  向上：2
  向下：4
  向左：8
  向右：16
  
  注意：這些代碼可以組合，例如同時按向上和中鍵時，
  代碼可能為 1+2 = 3（視模組設計而定）
*/

// ================================================================
// =============== 自訂函式宣告區（介面原型宣告） ===============
// ================================================================

// ---------- 基礎控制函式 ----------
void initVoice();                    // 初始化語音模組（必須在 setup() 中呼叫）
uint8_t getBoardKey();               // 從 BMV31T001 模組讀取按鍵狀態
void DisplayVoiceStatus();           // 根據播放狀態控制 LED（發亮代表正在播放）
void setVolume(uint8_t volume);      // 設定音量等級（0~11）

// ---------- 播放控制函式 ----------
void play(uint8_t num);              // 播放單段語音（不循環）
void playloop(uint8_t num);          // 循環播放單段語音
void playsentence(uint8_t num);      // 播放「語句」（語音模組內另一種播放模式）
void playsentenceloop(uint8_t num);  // 循環播放語句
void playstop();                     // 停止播放
void playPause();                    // 暫停播放
void playContinue();                 // 繼續播放
void playRepeat();                   // 重複播放（重播目前語音）
boolean isPlaying();                 // 回傳播放狀態（true = 正在播放）

// ---------- 電源與指示燈控制 ----------
void setVoicePower(uint8_t status);  // 開關語音模組電源
void setVoiceLed(uint8_t status);    // 控制語音模組上狀態指示燈

// ---------- 高階語音功能 ----------
void saynumber(int num);             // 念出單一數字（0~9）
boolean checknum(String ss);         // 檢查字串是否為單一數字字元 (0~9)
void sayText(uint8_t num);           // 播放 voice_table 中指定索引的語音
void SpeakStringNumber(String snum); // 將一整串數字字串逐位念出（可含小數點與負號）
void SayHello();                     // 播放開頭歡迎語
void SayTemperature(String snum);    // 播放「現在溫度 + 數值 + 單位」
void SayHumidity(String snum);       // 播放「現在濕度 + 數值 + 單位」
void SayString(uint8_t vv);          // 播放一段文字（單一語音）
void SayString(uint8_t vv, uint8_t vv2); // 連續播放兩段文字（兩段語音）

// ================================================================
// =============== 自定義函式內容程式區 ===============
// ================================================================

// ---------------------------------------------------------------
// 函式名稱：initVoice()
// 功能：初始化語音模組
// 參數：無
// 傳回值：無
// 
// 流程說明：
//   1. 呼叫 begin() 初始化模組通訊介面（I2C 或 UART）
//   2. 啟用模組電源
//   3. 進入音訊更新準備模式（若需要透過 PC 更新語音檔）
//   4. 延遲 100ms 等待模組穩定
//   5. 設定預設音量
// 
// 注意事項：
//   - 此函式必須在 setup() 中呼叫
//   - 若語音檔已寫入，initAudioUpdate() 仍可正常運作
// ---------------------------------------------------------------
void initVoice()
{
    // 步驟1：初始化 BMV31T001 模組
    // 設定通訊介面（I2C / UART 依函式庫實作）
    myBMV31T001.begin();
    
    // 步驟2：啟用語音模組電源
    // BMV31T001_POWER_ENABLE 為開啟電源
    myBMV31T001.setPower(BMV31T001_POWER_ENABLE);
    
    // 步驟3：進入音訊更新準備模式
    // 若要透過 PC 更新語音檔，此步驟必要
    // 若無需更新，此函式仍可呼叫，不影響正常播放
    myBMV31T001.initAudioUpdate();
    
    // 步驟4：延遲 100ms，讓模組穩定
    delay(100);
    
    // 步驟5：設定預設音量等級
    // DEFAULT_VOLUME = 9（接近最大音量）
    myBMV31T001.setVolume(DEFAULT_VOLUME);
}

// ---------------------------------------------------------------
// 函式名稱：getBoardKey()
// 功能：讀取語音模組板載按鍵狀態
// 參數：無
// 傳回值：uint8_t - 按鍵代碼（0=無按鍵，1=中鍵，2=上，4=下，8=左，16=右）
// 
// 使用說明：
//   1. 必須先呼叫 scanKey() 讓模組更新按鍵狀態
//   2. 透過 isKeyAction() 判斷是否有按鍵事件
//   3. 若有按鍵，則讀取按鍵代碼並回傳
// ---------------------------------------------------------------
uint8_t getBoardKey()
{
    // 步驟1：掃描按鍵狀態
    // 此函式會更新模組內部的按鍵狀態暫存器
    myBMV31T001.scanKey();

    // 步驟2：判斷是否有按鍵動作
    // isKeyAction() 回傳 BMV31T001_NO_KEY 表示無按鍵
    if (myBMV31T001.isKeyAction() != BMV31T001_NO_KEY)
        // 有按鍵：讀取按鍵代碼並回傳
        return myBMV31T001.readKeyValue();
    else
        // 無按鍵：回傳 0
        return 0x00;
}

// ---------------------------------------------------------------
// 函式名稱：DisplayVoiceStatus()
// 功能：顯示播放狀態，並同步控制模組上的 LED 指示燈
// 參數：無
// 傳回值：無
// 
// 說明：
//   - 當模組正在播放語音時，LED 亮起
//   - 當模組閒置時，LED 熄滅
//   - 可定期呼叫此函式來更新 LED 狀態
// ---------------------------------------------------------------
void DisplayVoiceStatus()
{
    // 步驟1：檢查播放狀態
    // isPlaying() 回傳 BMV31T001_BUSY 表示正在播放
    if (myBMV31T001.isPlaying() == BMV31T001_BUSY)
    {
        // 正在播放：更新狀態變數為「忙碌中」
        playStatus = BMV31T001_BUSY;
        // LED 亮起，表示正在播放
        myBMV31T001.setLED(BMV31T001_LED_ON);
    }
    else
    {
        // 未播放：狀態為「非忙碌」（閒置或停止）
        playStatus = BMV31T001_NOBUSY;
        // LED 熄滅
        myBMV31T001.setLED(BMV31T001_LED_OFF);
    }
}

// ---------------------------------------------------------------
// 函式名稱：setVolume()
// 功能：設定語音播放音量
// 參數：volume - 音量等級（0~11）
//        0：靜音
//        1~10：逐漸增大
//        11：最大音量
// 傳回值：無
// ---------------------------------------------------------------
void setVolume(uint8_t volume)
{
    // 直接呼叫底層函式設定音量
    // 音量等級範圍：0 ~ 11
    myBMV31T001.setVolume(volume);
}

// ---------------------------------------------------------------
// 函式名稱：play()
// 功能：播放單段語音（一次性播放，不循環）
// 參數：num - 語音編號（0~255，需與寫入模組的語音檔編號對應）
// 傳回值：無
// 
// 說明：
//   第二個參數 0：僅播放一次，不循環
//   播放完成後自動停止
// ---------------------------------------------------------------
void play(uint8_t num)
{
    // 參數說明：
    //   num：語音編號 (0~255，實際需與 Voice Widget 設定相對應)
    //   第二個參數 0：僅播放一次，不循環
    myBMV31T001.playVoice(num, 0);
}

// ---------------------------------------------------------------
// 函式名稱：playloop()
// 功能：循環播放單段語音（重複播放，直到手動停止）
// 參數：num - 語音編號
// 傳回值：無
// 
// 說明：
//   第二個參數 1：重複循環播放同一段語音
//   需要呼叫 playstop() 才能停止
// ---------------------------------------------------------------
void playloop(uint8_t num)
{
    // 參數說明：
    //   第二個參數 1：重複循環播放同一段語音
    myBMV31T001.playVoice(num, 1);
}

// ---------------------------------------------------------------
// 函式名稱：playsentence()
// 功能：播放語句（Sentence 模式）
// 參數：num - 語句編號
// 傳回值：無
// 
// 說明：
//   語句模式可將多個語音片段組合成一個完整的句子
//   例如：「現在溫度」+「25.5」+「攝氏度」組合成一句話
// ---------------------------------------------------------------
void playsentence(uint8_t num)
{
    // 參數說明：
    //   num：語句索引
    //   第二個參數 0：僅播放一次
    myBMV31T001.playSentence(num, 0);
}

// ---------------------------------------------------------------
// 函式名稱：playsentenceloop()
// 功能：循環播放語句
// 參數：num - 語句編號
// 傳回值：無
// ---------------------------------------------------------------
void playsentenceloop(uint8_t num)
{
    // 參數說明：
    //   第二個參數 1：重複循環播放同一個句子
    myBMV31T001.playSentence(num, 1);
}

// ---------------------------------------------------------------
// 函式名稱：playstop()
// 功能：停止當前播放的語音
// 參數：無
// 傳回值：無
// 
// 說明：
//   立即停止所有正在播放的語音
//   包括普通播放模式和循環播放模式
// ---------------------------------------------------------------
void playstop()
{
    myBMV31T001.playStop();
}

// ---------------------------------------------------------------
// 函式名稱：playPause()
// 功能：暫停當前播放的語音
// 參數：無
// 傳回值：無
// 
// 說明：
//   暫停後可透過 playContinue() 從暫停處繼續播放
//   適合需要暫時中斷語音的場景
// ---------------------------------------------------------------
void playPause()
{
    myBMV31T001.playPause();
}

// ---------------------------------------------------------------
// 函式名稱：playContinue()
// 功能：繼續播放被暫停的語音
// 參數：無
// 傳回值：無
// 
// 說明：
//   與 playPause() 配對使用，從暫停處繼續播放
// ---------------------------------------------------------------
void playContinue()
{
    myBMV31T001.playContinue();
}

// ---------------------------------------------------------------
// 函式名稱：playRepeat()
// 功能：重複播放當前語音（從頭開始）
// 參數：無
// 傳回值：無
// 
// 說明：
//   適合需要重複聽取同一段語音的場景
// ---------------------------------------------------------------
void playRepeat()
{
    myBMV31T001.playRepeat();
}

// ---------------------------------------------------------------
// 函式名稱：isPlaying()
// 功能：檢查是否正在播放語音
// 參數：無
// 傳回值：boolean - true：正在播放，false：未播放
// 
// 使用時機：
//   在播放下一段語音前，可先呼叫此函式確保前一段已播放完畢
// ---------------------------------------------------------------
boolean isPlaying()
{
    // isPlaying() 內部會回傳 BMV31T001_BUSY 或 BMV31T001_NOBUSY
    // 轉換為 boolean 型態回傳
    return myBMV31T001.isPlaying();
}

// ---------------------------------------------------------------
// 函式名稱：setVoicePower()
// 功能：控制語音模組電源開關
// 參數：status - 電源狀態
//          BMV31T001_POWER_ENABLE：開啟電源
//          BMV31T001_POWER_DISABLE：關閉電源
// 傳回值：無
// 
// 應用場景：
//   節省電力：長時間不使用時可關閉語音模組電源
// ---------------------------------------------------------------
void setVoicePower(uint8_t status)
{
    myBMV31T001.setPower(status);
}

// ---------------------------------------------------------------
// 函式名稱：setVoiceLed()
// 功能：控制語音模組上的狀態指示燈
// 參數：status - LED 狀態
//          BMV31T001_LED_ON：LED 亮
//          BMV31T001_LED_OFF：LED 滅
// 傳回值：無
// 
// 應用場景：
//   播放語音時點亮 LED，提示使用者目前正在播放
// ---------------------------------------------------------------
void setVoiceLed(uint8_t status)
{
    myBMV31T001.setLED(status);
}

// ---------------------------------------------------------------
// 函式名稱：saynumber()
// 功能：播放單一數字（0~9）所對應的語音
// 參數：num - 要播放的數字（0~9）
// 傳回值：無
// 
// 流程說明：
//   1. 檢查數字是否在 0~9 範圍內
//   2. 等待前一段語音播放完畢
//   3. 播放對應數字的語音
// 
// 注意事項：
//   若傳入數字超出範圍，會在序列埠顯示錯誤訊息
// ---------------------------------------------------------------
void saynumber(int num)
{
    // 步驟1：檢查輸入範圍
    if (num < 0 || num > 9)
    {
        Serial.println("Wrong Number：僅允許 0~9 數字");
        return;
    }

    // 步驟2：等待前一段語音播放完畢
    // 避免語音重疊
    if (isPlaying())
        while (isPlaying());

    // 步驟3：播放對應數字語音
    // voice_table[num] 內存放的是對應數字的 VOC_xx 常數
    // 例如：num=0 → voice_table[0] = VOC_1（數字0的語音）
    //       num=1 → voice_table[1] = VOC_2（數字1的語音）
    while (!isPlaying())
    {
        play(voice_table[num]);
    }
}

// ---------------------------------------------------------------
// 函式名稱：checknum()
// 功能：檢查字串是否為「單一數字字元」（0~9）
// 參數：ss - 要檢查的字串
// 傳回值：boolean - true：是單一數字，false：不是數字或長度不為1
// 
// 使用範例：
//   checknum("5") → true
//   checknum("12") → false（長度不為1）
//   checknum("A") → false（不是數字）
// ---------------------------------------------------------------
boolean checknum(String ss)
{
    String numberchar = "0123456789"; // 合法數字字元集合

    // 若長度不是 1，必定不是單一數字
    if (ss.length() != 1)
        return false;

    // 判斷字串中唯一的字元是否存在於 numberchar 中
    // indexOf() 回傳 -1 表示找不到
    if (numberchar.indexOf(ss.charAt(0)) >= 0)
        return true;  // 是 0~9 數字
    else
        return false; // 非數字
}

// ---------------------------------------------------------------
// 函式名稱：sayText()
// 功能：播放語音表中第 num 筆的語音內容
// 參數：num - 語音表索引（0~37）
// 傳回值：無
// 
// 說明：
//   此函式會從 voice_table 中取出對應的語音編號並播放
//   播放前會等待前一段語音結束
// ---------------------------------------------------------------
void sayText(uint8_t num)
{
    // 步驟1：等待前一段語音播放完畢
    if (isPlaying())
        while (isPlaying());

    // 步驟2：在模組閒置時開始播放指定語音
    while (!isPlaying())
    {
        // 播放 voice_table[num] 對應的 VOC_xx
        play(voice_table[num]);
    }
}

// ---------------------------------------------------------------
// 函式名稱：SpeakStringNumber()
// 功能：播放「數字字串」，將字串中的每個字元逐位念出
// 參數：snum - 要念讀的數字字串
//         例如："23.5" → 依序念出：2、3、「點」、5
//         "-10"   → 念出：「負」、1、0
// 傳回值：無
// 
// 支援的符號：
//   - 數字：0~9
//   - 小數點：「.」→ 念出「點」
//   - 負號：「-」→ 念出「負」
// ---------------------------------------------------------------
void SpeakStringNumber(String snum)
{
    if (snum.length() == 0)
        return; // 空字串不處理

    int le = snum.length();
    String cc;

    for (int i = 0; i < le; i++)
    {
        cc = snum.substring(i, i + 1); // 依序取出每一個字元

        if (checknum(cc))
        {
            // 若是 0~9 數字，轉成 int 之後呼叫 saynumber()
            saynumber(cc.toInt());
        }
        else
        {
            // 若是非數字，處理小數點與負號
            if (cc == ".")
                sayText(VOC_11); // VOC_11 對應「點」
            if (cc == "-")
                sayText(VOC_12); // VOC_12 對應「負」
        }
    }
}

// ---------------------------------------------------------------
// 函式名稱：SayHello()
// 功能：播放開頭歡迎語
// 參數：無
// 傳回值：無
// 
// 說明：
//   播放前會點亮 LED，播放完成後熄滅 LED
//   適合在系統啟動時使用
// ---------------------------------------------------------------
void SayHello()
{
    setVoiceLed(1);        // 亮 LED 表示正在播放提示
    sayText(VOC_13);       // 播放「開頭文字或歡迎字」（實際內容由語音檔決定）
    setVoiceLed(0);        // 播放完畢後熄滅 LED
}

// ---------------------------------------------------------------
// 函式名稱：SayTemperature()
// 功能：播放溫度資訊：「現在溫度」 + 數值 + 「攝氏度」
// 參數：snum - 溫度數值字串，例如 "23.5" 或 "25"
// 傳回值：無
// 
// 播放流程：
//   1. 亮 LED 指示播放中
//   2. 播放「現在溫度」（VOC_14）
//   3. 逐位念出溫度數值（支援小數點）
//   4. 播放「攝氏度」（VOC_16）
//   5. 熄滅 LED
// ---------------------------------------------------------------
void SayTemperature(String snum)
{
    setVoiceLed(1);          // 亮 LED

    sayText(VOC_14);         // 播放「現在溫度」或類似提示
    SpeakStringNumber(snum); // 逐位念出數字（可含小數點與負號）
    sayText(VOC_16);         // 播放「攝氏度」或單位語音

    setVoiceLed(0);          // 熄滅 LED
}

// ---------------------------------------------------------------
// 函式名稱：SayHumidity()
// 功能：播放濕度資訊：「現在濕度」 + 數值 + 「百分比」
// 參數：snum - 濕度數值字串，例如 "65" 或 "85.5"
// 傳回值：無
// 
// 播放流程：
//   1. 亮 LED 指示播放中
//   2. 播放「現在濕度」（VOC_15）
//   3. 逐位念出濕度數值（支援小數點）
//   4. 播放「百分比」（VOC_17）
//   5. 熄滅 LED
// ---------------------------------------------------------------
void SayHumidity(String snum)
{
    setVoiceLed(1);          // 亮 LED

    sayText(VOC_15);         // 播放「現在濕度」或類似提示
    SpeakStringNumber(snum); // 念出數字
    sayText(VOC_17);         // 播放「百分比」或其他單位

    setVoiceLed(0);          // 熄滅 LED
}

// ---------------------------------------------------------------
// 函式名稱：SayString()
// 功能：播放一段語音（單一語音代碼）
// 參數：vv - 語音表索引（0~37）或直接傳入 VOC_xx 常數
// 傳回值：無
// 
// 說明：
//   播放前點亮 LED，播放完成後熄滅 LED
// ---------------------------------------------------------------
void SayString(uint8_t vv)
{
    setVoiceLed(1);    // 播放期間 LED 亮
    sayText(vv);       // 依傳入之語音代碼（或索引）播放
    setVoiceLed(0);    // 播放完成 LED 滅
}

// ---------------------------------------------------------------
// 函式名稱：SayString() - 多載版本
// 功能：連續播放二段語音（例如「前門」+「入侵警示」）
// 參數：
//   vv - 第一段語音代碼（或索引）
//   vv2 - 第二段語音代碼（或索引）
// 傳回值：無
// 
// 播放流程：
//   1. 亮 LED
//   2. 播放第一段語音
//   3. 延遲 300ms 避免兩段語音連在一起
//   4. 播放第二段語音
//   5. 熄滅 LED
// ---------------------------------------------------------------
void SayString(uint8_t vv, uint8_t vv2)
{
    setVoiceLed(1);    // 播放期間 LED 亮

    sayText(vv);       // 先播放第一段語音
    delay(300);        // 兩段語音之間留 0.3 秒間隔
    sayText(vv2);      // 播放第二段語音
    setVoiceLed(0);    // 播放完成 LED 滅
}

// ================================================================
// ===================== 使用注意事項 ============================
// ================================================================
/*
重要提醒：

1. 語音檔準備：
   - 使用前必須透過 PC 工具將語音檔寫入 BMV31T001 模組
   - 語音編號（VOC_1 ~ VOC_38）必須與寫入的語音檔對應
   - 建議製作語音對照表，方便日後維護

2. 硬體接線：
   - 確認電源供應穩定（3.3V 或 5V，依模組規格）
   - I2C 通訊需連接 SDA、SCL 腳位
   - UART 通訊需連接 TX、RX 腳位
   - 確保接地（GND）共接

3. 初始化順序：
   - 必須先呼叫 initVoice() 才能使用其他功能
   - 建議在 setup() 中呼叫，並加入適當延遲等待模組穩定

4. 播放控制：
   - 播放前可先呼叫 isPlaying() 確認模組空閒
   - 避免在播放中再次呼叫 play() 造成語音重疊
   - 循環播放模式需要手動呼叫 playstop() 才能停止

5. 音量設定：
   - 音量範圍 0~11，0 為靜音，11 為最大
   - 可根據使用環境調整音量大小
   - 建議在初始化時設定預設音量

6. 按鍵讀取：
   - 必須先呼叫 scanKey() 才能讀取最新狀態
   - 按鍵代碼可組合（如同時按多鍵）
   - 建議加入按鍵去抖動處理

7. LED 指示燈：
   - 可根據播放狀態自動控制 LED
   - 也可手動控制 LED 用於其他用途
   - LED 狀態可幫助使用者了解模組運作情況

8. 電源管理：
   - 長時間不使用時可關閉模組電源節省電力
   - 重新開啟電源後需重新初始化
   - 電池供電設備應注意功耗管理

9. 錯誤處理：
   - 播放失敗時檢查語音檔是否存在
   - 通訊異常時檢查硬體接線
   - 可加入重試機制提高穩定性

10. 語音內容設計：
    - 建議使用清晰、標準的語音錄製
    - 數字語音應保持一致的語調
    - 單位語音（攝氏度、百分比）應明確易懂
    - 可根據應用場景設計專屬的語音內容
*/